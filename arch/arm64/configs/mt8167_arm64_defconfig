## arch/arm64/configs/mt8167_arm64_defconfig
```kconfig
# MT8167 LibreEcho Lidar.  The option list is `make savedefconfig` output;
# the comments explain overrides whose reason is not obvious.
# CONFIG_LOCALVERSION_AUTO is not set
CONFIG_NO_HZ_IDLE=y
CONFIG_HIGH_RES_TIMERS=y
CONFIG_IKCONFIG=y
CONFIG_IKCONFIG_PROC=y
CONFIG_BLK_DEV_INITRD=y
CONFIG_CC_OPTIMIZE_FOR_SIZE=y
CONFIG_ARCH_MEDIATEK=y
CONFIG_COMPAT=y
CONFIG_CPU_FREQ=y
# mediatek-cpufreq walks the "intermediate" clock and the vproc rail; cpufreq-dt
# has no machine entry for MT8167.
CONFIG_ARM_MEDIATEK_CPUFREQ=y
CONFIG_NET=y
CONFIG_PACKET=y
CONFIG_UNIX=y
CONFIG_INET=y
CONFIG_IP_MULTICAST=y
CONFIG_BT=y
CONFIG_BT_MTKSDIO=y
CONFIG_CFG80211=y
CONFIG_CFG80211_WEXT=y
CONFIG_RFKILL=y
CONFIG_DEVTMPFS=y
CONFIG_DEVTMPFS_MOUNT=y
CONFIG_BLK_DEV_LOOP=y
CONFIG_AMZ_PRIVACY=y
CONFIG_NETDEVICES=y
CONFIG_MT7668_SDIO=y
CONFIG_INPUT_EVDEV=y
CONFIG_KEYBOARD_GPIO=y
CONFIG_SERIAL_8250=y
CONFIG_SERIAL_8250_CONSOLE=y
CONFIG_SERIAL_8250_MT6577=y
CONFIG_I2C=y
CONFIG_I2C_CHARDEV=y
CONFIG_I2C_MT65XX=y
# CONFIG_PTP_1588_CLOCK is not set
CONFIG_SYSCON_REBOOT_MODE=y
CONFIG_SENSORS_TMP108=y
CONFIG_SENSORS_LM75=y
CONFIG_THERMAL=y
CONFIG_CPU_THERMAL=y
CONFIG_WATCHDOG=y
CONFIG_MFD_SYSCON=y
CONFIG_REGULATOR_FIXED_VOLTAGE=y
CONFIG_REGULATOR_RT5739=y
CONFIG_SOUND=y
CONFIG_SND=y
CONFIG_SND_SOC=y
CONFIG_SND_SOC_MT8516=y
CONFIG_SND_SOC_MT8516_AMAZON_LIDAR=y
CONFIG_USB=y
CONFIG_USB_MUSB_HDRC=y
CONFIG_USB_MUSB_MEDIATEK=y
CONFIG_USB_INVENTRA_DMA=y
CONFIG_NOP_USB_XCEIV=y
CONFIG_USB_GADGET=y
CONFIG_USB_CONFIGFS=y
CONFIG_USB_CONFIGFS_ACM=y
CONFIG_USB_CONFIGFS_NCM=y
CONFIG_USB_CONFIGFS_F_FS=y
CONFIG_MMC=y
CONFIG_MMC_MTK=y
CONFIG_NEW_LEDS=y
CONFIG_LEDS_CLASS=y
CONFIG_LEDS_IS31FL32XX=y
CONFIG_IIO=y
CONFIG_SENSORS_TSL2540=y
CONFIG_MCP4531=y
CONFIG_PHY_MTK_TPHY=y
CONFIG_EXT4_FS=y
CONFIG_TMPFS=y
CONFIG_SQUASHFS=y
CONFIG_SQUASHFS_LZ4=y
CONFIG_PSTORE=y
CONFIG_PSTORE_CONSOLE=y
CONFIG_PSTORE_PMSG=y
CONFIG_PSTORE_RAM=y
CONFIG_DEBUG_FS=y
CONFIG_PANIC_TIMEOUT=10
```

## drivers/net/wireless/mediatek/mt7668/Kconfig
```kconfig
# SPDX-License-Identifier: GPL-2.0-only
config MT7668_SDIO
	tristate "MediaTek MT7668 (gen4) SDIO WLAN support"
	depends on MMC
	depends on CFG80211
	help
	  This is MediaTek's gen4 WLAN driver for the MT7668 SDIO combo
	  chip, as found in the Amazon Echo Plus (2nd generation) and other
	  MT8167/MT8516 devices. Bluetooth on the same chip is handled by
	  btmtksdio.

	  The driver needs the MediaTek firmware files
	  (WIFI_RAM_CODE_MT7668.bin, WIFI_RAM_CODE2_SDIO_MT7668.bin) and
	  the ROM patch, which are not part of linux-firmware and must be
	  taken from the device's vendor image. Install the ROM patch as
	  mt7668_patch_e1_hdr.bin or mt7668_patch_e2_hdr.bin, matching the
	  ROM version reported by the chip.

	  To compile this driver as a module, choose M here: the module will
	  be called mt7668_sdio.
```
